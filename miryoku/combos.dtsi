/*                KEY POSITIONS

  ╭─────────────────────╮ ╭─────────────────────╮
  │ LT4 LT3 LT2 LT1 LT0 │ │ RT0 RT1 RT2 RT3 RT4 │
  │ LM4 LM3 LM2 LM1 LM0 │ │ RM0 RM1 RM2 RM3 RM4 │
  │ LB4 LB3 LB2 LB1 LB0 │ │ RB0 RB1 RB2 RB3 RB4 │
  ╰───────╮ LH2 LH1 LH0 │ │ RH0 RH1 RH2 ╭───────╯
          ╰─────────────╯ ╰─────────────╯ */
#include "zmk-helpers/helper.h"
#include "zmk-helpers/key-labels/42.h"

#define COMBO_TERM_FAST 18
#define COMBO_TERM_SLOW 30

#define COMBO_IDLE_FAST 150
#define COMBO_IDLE_SLOW 50

/*                KEY POSITIONS

  ╭─────────────────────╮ ╭─────────────────────╮
  │ ((( {{{ [[[ <<< !!! │ │ === >>> ]]] }}} ))) │
  │ LM4 LM3 LM2 LM1 LM0 │ │ RM0 RM1 RM2 RM3 RM4 │
  │ LB4 %%% ``` @@@ LB0 │ │ RB0 &&& $$$ ||| RB4 │
  ╰───────╮ LH2 LH1 LH0 │ │ RH0 RH1 RH2 ╭───────╯
          ╰─────────────╯ ╰─────────────╯ */

ZMK_COMBO(lpar, &kp LPAR, LT4 LM4, ALL, COMBO_TERM_SLOW, COMBO_IDLE_SLOW)
ZMK_COMBO(rpar, &kp RPAR, RT4 RM4, ALL, COMBO_TERM_SLOW, COMBO_IDLE_SLOW)

ZMK_COMBO(lbrc, &kp LBRC, LT3 LM3, ALL, COMBO_TERM_SLOW, COMBO_IDLE_SLOW)
ZMK_COMBO(rbrc, &kp RBRC, RT3 RM3, ALL, COMBO_TERM_SLOW, COMBO_IDLE_SLOW)

ZMK_COMBO(lbkt, &kp LBKT, LT2 LM2, ALL, COMBO_TERM_SLOW, COMBO_IDLE_SLOW)
ZMK_COMBO(rbkt, &kp RBKT, RT2 RM2, ALL, COMBO_TERM_SLOW, COMBO_IDLE_SLOW)

ZMK_COMBO(lt, &kp LT, LT1 LM1, ALL, COMBO_TERM_SLOW, COMBO_IDLE_SLOW)
ZMK_COMBO(gt, &kp GT, RT1 RM1, ALL, COMBO_TERM_SLOW, COMBO_IDLE_SLOW)

ZMK_COMBO(excl, &kp EXCL, LT0 LM0, ALL, COMBO_TERM_FAST, COMBO_IDLE_FAST)
ZMK_COMBO(eq,&kp EQUAL, RT0 RM0, ALL, COMBO_TERM_FAST, COMBO_IDLE_FAST)



ZMK_COMBO(prcnt, &kp PRCNT, LM3 LB3, ALL, COMBO_TERM_SLOW, COMBO_IDLE_SLOW)
ZMK_COMBO(pipe, &kp PIPE, RM3 RB3, ALL, COMBO_TERM_SLOW, COMBO_IDLE_SLOW)

ZMK_COMBO(grave, &kp GRAVE, LM2 LB2, ALL, COMBO_TERM_SLOW, COMBO_IDLE_SLOW)
ZMK_COMBO(dllr, &kp DLLR, RM2 RB2, ALL, COMBO_TERM_SLOW, COMBO_IDLE_SLOW)

ZMK_COMBO(at, &kp AT, LM1 LB1, ALL, COMBO_TERM_SLOW, COMBO_IDLE_SLOW)
ZMK_COMBO(amps, &kp AMPS, RM1 RB1, ALL, COMBO_TERM_SLOW, COMBO_IDLE_SLOW)

